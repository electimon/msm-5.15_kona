/dts-v1/;
/plugin/;

#include "bengal-qrd.dtsi"

/ {
	model = "borneo";
	compatible = "qcom,bengal-borneo", "qcom,bengal-moto", "qcom,bengal";
	qcom,msm-id = <444 0x10000>;
	qcom,board-id = <0 0xB200>;
};
